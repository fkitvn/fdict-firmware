## components/board_fnk0104b/Kconfig
```kconfig
menu "Board FNK0104B (Freenove ESP32-S3 2.8\")"

    choice BOARD_ORIENTATION
        prompt "Huong man hinh"
        default BOARD_ORIENTATION_LANDSCAPE
        help
            LCD (swap_xy/mirror) va cam ung tu dong theo huong nay.
        config BOARD_ORIENTATION_LANDSCAPE
            bool "Ngang 320x240"
        config BOARD_ORIENTATION_PORTRAIT
            bool "Doc 240x320"
    endchoice

    config BOARD_ROTATE_180
        bool "Xoay 180 do"
        default n
        help
            Bat neu man hinh bi lon nguoc (LCD va cam ung cung xoay).

    config BOARD_LCD_PCLK_MHZ
        int "Tan so SPI LCD (MHz)"
        range 10 80
        default 40
        help
            Freenove TFT_eSPI dung 40MHz, xiaozhi dung 20MHz. Giam neu man hinh nhieu/soc.

    config BOARD_LCD_INVERT_COLOR
        bool "LCD dao mau (invert)"
        default y

    config BOARD_LCD_BGR
        bool "LCD thu tu mau BGR"
        default y

    config BOARD_BACKLIGHT_DEFAULT
        int "Do sang mac dinh (%)"
        range 0 100
        default 80
endmenu
```

## components/fd_ota/Kconfig
```kconfig
menu "FDict One OTA"

    config FD_OTA_LAB
        bool "LAB: may chu dict Lab/dev (chi build thu, KHONG phat hanh)"
        default n
        help
            Khong con chon server (giu cho tuong thich sdkconfig). Server chon luc chay theo Che do nha phat trien:
            bat = FD_OTA_LAB_BASE_URL (Lab/dev, mac dinh https + cert bundle), tat = FD_OTA_BASE_URL (https + cert bundle, khong tat kiem cert). Van cho phep http:// khi Lab neu URL Lab la http.

    config FD_OTA_LAB_BASE_URL
        string "LAB base URL (https uu tien, khong co /api; van chap nhan http LAN)"
        default "https://fdict-dev.joinnow.vn"

    config FD_OTA_BASE_URL
        string "Production base URL (https, khong co /api)"
        default "https://your-server.example"
        help
            Endpoint: {base}/api/ota/check, {base}/api/ota/report, {base}/api/devices/pair/start|poll.

    config FD_PAIR_LAB_WEB_URL
        string "LAB: trang ghep tren web (QR, them ?id=&hw=&fw=&b=)"
        default "https://fdict-dev.joinnow.vn/pairing-device"

    config FD_PAIR_WEB_URL
        string "Production: trang ghep tren web (QR, them ?code=<ma>)"
        default "https://your-server.example/pairing-device"

    config FD_OTA_HW
        string "Ma phan cung (hw)"
        default "fnk0104b"

    config FD_OTA_CHECK_INTERVAL_S
        int "Chu ky kiem tra mac dinh (giay)"
        range 3600 172800
        default 43200
        help
            Dung khi may chu khong tra check_again_s. check_again_s duoc kep 1 h..48 h, +-10% ngau nhien.

endmenu
```

## components/fd_power/Kconfig
```kconfig
menu "Fdict Power"
    config FD_BATTERY_ENABLE
        bool "Doc dien ap pin (ADC) va hien % pin tren UI"
        default y
    config FD_BATTERY_ADC_GPIO
        int "GPIO do dien ap pin (phai thuoc ADC1)"
        depends on FD_BATTERY_ENABLE
        range 1 10
        default 9
        help
            FNK0104A/B: GPIO9 (Freenove Sketch_05.1_Battery_Voltage). FNK0104N: GPIO8.
    config FD_BATTERY_DIVIDER
        int "He so cau chia ap x100 (200 = Vbat/2 vao ADC)"
        depends on FD_BATTERY_ENABLE
        range 100 1000
        default 200
endmenu
```

## components/fd_ui/Kconfig
```kconfig
menu "FDict One UI"

    config FD_SLEEP_BTN
        bool "Nut Ngu (deep sleep) trong bang cai dat nhanh"
        default y
        help
            Hien nut Ngu trong bang keo xuong; xac nhan -> deep sleep ( danh thuc bang nut bat ky).
            Disable if sleep (soft power-off) misbehaves, e.g. shared I2C with ES8311 on the Freenove board.

endmenu
```

## main/Kconfig.projbuild
```kconfig
menu "Fdict"

    config FD_TZ
        string "Mui gio (POSIX TZ)"
        default "ICT-7"
        help
            ICT-7 = Asia/Bangkok, UTC+7, khong doi gio mua he.

    config FD_NTP_SERVER
        string "May chu NTP"
        default "pool.ntp.org"

    menu "WiFi tuong thich (debug)"
        config FD_WIFI_SAE_AUTO
            bool "Chi bat WPA3/SAE khi AP quang ba WPA3 (WPA/WPA2 -> tat SAE, nguong WPA_PSK)"
            default y
        config FD_WIFI_HT20_BGN
            bool "Ep 802.11 b/g/n + bang thong HT20"
            default y
        config FD_WIFI_INIT_BEFORE_DISPLAY
            bool "Khoi dong WiFi truoc LCD/backlight/LVGL"
            default y
        config FD_WIFI_TX_POWER_QDBM
            int "Cong suat phat toi da (don vi 0.25 dBm, 0 = mac dinh, vd 52 = 13 dBm, 80 = 20 dBm)"
            range 0 84
            default 0
    endmenu

    config FD_API_BASE_URL
        string "Base URL API thiet bi"
        default "https://your-server.example/api/device/v1"

    config FD_HEAP_LOG_PERIOD_S
        int "Chu ky log heap (giay, 0 = tat)"
        default 60
        help
            Dung cho test chay 1 gio khong ro heap.
endmenu
```

## sdkconfig.defaults.release
```kconfig
# Dung: idf.py -D SDKCONFIG_DEFAULTS="sdkconfig.defaults;sdkconfig.defaults.esp32s3;sdkconfig.defaults.release" build
CONFIG_COMPILER_OPTIMIZATION_ASSERTIONS_SILENT=y
CONFIG_LOG_DEFAULT_LEVEL_WARN=y
CONFIG_LV_USE_PERF_MONITOR=n
CONFIG_LV_USE_SYSMON=n
```
